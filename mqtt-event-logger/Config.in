## mqtt-event-logger/Config.in
```kconfig
source "$BR2_EXTERNAL_MQTT_EVENT_LOGGER_PATH/package/mqtt-subscriber/Config.in"
source "$BR2_EXTERNAL_MQTT_EVENT_LOGGER_PATH/package/mqttlog-device/Config.in"
```

## mqtt-event-logger/package/mqtt-char-driver/Config.in
```kconfig
config BR2_PACKAGE_MQTT_CHAR_DRIVER
	bool "mqtt-char-driver"
	depends on BR2_LINUX_KERNEL
	help
	  Implements a character device that provides kernel-space event logging for mqtt messages.
	  Stores incoming events in a ring buffer and exposes them to user-space applications through standard Linux file operations such as read() and poll().
```

## mqtt-event-logger/package/mqtt-subscriber/Config.in
```kconfig
menuconfig BR2_PACKAGE_MQTT_SUBSCRIBER
	bool "mqtt-subscriber"
	select BR2_TOOLCHAIN_BUILDROOT_CXX
	select BR2_PACKAGE_OPENSSL
	help
	  User-space application that connects to a Mosquitto broker and listens for messages on configurable topics.
	  Converts incoming MQTT messages into a structured event format and either logs them or forwards them to the kernel module through the character device interface.


if BR2_PACKAGE_MQTT_SUBSCRIBER

config BR2_CHAR_HASH
	string
	default "\x23"

config BR2_PACKAGE_MQTT_SUBSCRIBER_MQTT_HOST
	string "MQTT host"
	default "mqtt://localhost:1883"

config BR2_PACKAGE_MQTT_SUBSCRIBER_MQTT_TOPIC
	string "MQTT topic"
	default "\\$(BR2_CHAR_HASH)"
endif
```

## mqtt-event-logger/package/mqttlog-device/Config.in
```kconfig
config BR2_PACKAGE_MQTTLOG_DEVICE
	bool "mqttlog-device"
	depends on BR2_LINUX_KERNEL
	help
	  Implements a character device that provides kernel-space event logging for mqtt messages.
	  Stores incoming events in a ring buffer and exposes them to user-space applications through standard Linux file operations such as read() and poll().
```

## mqtt-event-logger/package/mqttlogctl/Config.in
```kconfig
config BR2_PACKAGE_MQTTLOGCTL
	bool "mqttlogctl"
	depends on BR2_PACKAGE_MQTTLOG_DEVICE
	depends on BR2_PACKAGE_HOST_RUSTC_TARGET_ARCH_SUPPORTS
	select BR2_PACKAGE_HOST_RUSTC
	help
	  Implements a userspace command-line utility for interacting with the mqttlog kernel module.
	  Supports reading events, configuring topic filters, resetting the ring buffer, and retrieving runtime statistics.
```
